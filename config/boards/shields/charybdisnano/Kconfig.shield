## config/boards/shields/charybdisnano/Kconfig.shield
```kconfig
# Copyright (c) 2020 The ZMK Contributors
# SPDX-License-Identifier: MIT

config SHIELD_CHARYBDISNANO_CENTRAL_DONGLE
    def_bool $(shields_list_contains,charybdisnano_central_dongle)

config SHIELD_CHARYBDISNANO_CENTRAL_LEFT
    def_bool $(shields_list_contains,charybdisnano_central_left)
    
config SHIELD_CHARYBDISNANO_PERIPHERAL_LEFT
    def_bool $(shields_list_contains,charybdisnano_peripheral_left)

config SHIELD_CHARYBDISNANO_PERIPHERAL_RIGHT
    def_bool $(shields_list_contains,charybdisnano_peripheral_right)
```

## config/west.yml
```yaml
manifest:
  remotes:
    - name: zmkfirmware
      url-base: https://github.com/petejohanson
    - name: inorichi
      url-base: https://github.com/inorichi
    - name: badjeff
      url-base: https://github.com/badjeff
  projects:
    - name: zmk
      remote: zmkfirmware
      revision: feat/pointers-move-scroll
      import: app/west.yml
    - name: zmk-pmw3610-driver
      remote: inorichi
      revision: main
    - name: zmk-split-peripheral-input-relay
      remote: badjeff
      revision: main
  self:
    path: config
```
